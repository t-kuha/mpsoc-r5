## zephyr/src/ultra96v2/Kconfig.board
```kconfig
# Copyright (c) 2020, Antmicro
# SPDX-License-Identifier: Apache-2.0
config BOARD_ULTRA96V2
	bool "Avnet Ultra96 v2 board"
	depends on SOC_XILINX_ZYNQMP_RPU
```

## zephyr/src/ultra96v2/Kconfig.defconfig
```kconfig
# Copyright (c) 2020, Antmicro
# SPDX-License-Identifier: Apache-2.0

if BOARD_ULTRA96V2

config BOARD
	default "ultra96v2"

config FLASH_SIZE
	int
	default 64

config FLASH_BASE_ADDRESS
	default 0x08000000

endif
```
